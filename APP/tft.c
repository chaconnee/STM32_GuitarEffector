#include "tft.h"
#include "spi.h"
#include "main.h"

#define TFT_CS_LOW   HAL_GPIO_WritePin(GPIOB, GPIO_PIN_5, GPIO_PIN_RESET)
#define TFT_CS_HIGH  HAL_GPIO_WritePin(GPIOB, GPIO_PIN_5, GPIO_PIN_SET)
#define TFT_DC_CMD   HAL_GPIO_WritePin(GPIOB, GPIO_PIN_9, GPIO_PIN_RESET)
#define TFT_DC_DATA  HAL_GPIO_WritePin(GPIOB, GPIO_PIN_9, GPIO_PIN_SET)
#define TFT_RST_LOW  HAL_GPIO_WritePin(GPIOB, GPIO_PIN_8, GPIO_PIN_RESET)
#define TFT_RST_HIGH HAL_GPIO_WritePin(GPIOB, GPIO_PIN_8, GPIO_PIN_SET)

#define WIDTH   160
#define HEIGHT  80
#define FONT_W  6
#define FONT_H  10

static void SPI_WriteCmd(uint8_t cmd)
{
    TFT_CS_LOW; TFT_DC_CMD;
    HAL_SPI_Transmit(&hspi1, &cmd, 1, 100);
    TFT_CS_HIGH;
}

static void SPI_WriteCmdEx(uint8_t cmd, uint8_t *data, uint32_t len)
{
    TFT_CS_LOW; TFT_DC_CMD;
    HAL_SPI_Transmit(&hspi1, &cmd, 1, 100);
    if (len) { TFT_DC_DATA; HAL_SPI_Transmit(&hspi1, data, len, 100); }
    TFT_CS_HIGH;
}

static void SPI_WriteData16(uint16_t data)
{
    TFT_CS_LOW; TFT_DC_DATA;
    uint8_t b[2] = { data >> 8, data & 0xFF };
    HAL_SPI_Transmit(&hspi1, b, 2, 100);
    TFT_CS_HIGH;
}

/* Set CASET/RASET window */
static void TFT_SetWindow(uint16_t x, uint16_t y, uint16_t w, uint16_t h)
{
    uint16_t x1 = x + 1, x2 = x + w;
    uint16_t y1 = y + 26, y2 = y + h - 1 + 26;

    SPI_WriteCmd(0x2A);
    TFT_CS_LOW; TFT_DC_DATA;
    { uint16_t v = x1; SPI_WriteData16(v); } { uint16_t v = x2; SPI_WriteData16(v); }
    TFT_CS_HIGH;

    SPI_WriteCmd(0x2B);
    TFT_CS_LOW; TFT_DC_DATA;
    { uint16_t v = y1; SPI_WriteData16(v); } { uint16_t v = y2; SPI_WriteData16(v); }
    TFT_CS_HIGH;
}

/* ── 5×7 Font (6×10 cells) ── */
static const uint8_t font5x7[96][5] = {
    {0x00,0x00,0x00,0x00,0x00}, /*   */
    {0x00,0x00,0x5F,0x00,0x00}, /* ! */
    {0x00,0x07,0x00,0x07,0x00}, /* " */
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    {0x44,0x64,0x54,0x4C,0x44}, /* z */
};

void TFT_DrawChar(uint16_t x, uint16_t y, char c, uint16_t color)
{
    if (c < 32 || c > 127) c = 32;
    const uint8_t *glyph = font5x7[c - 32];
    uint8_t bg[2] = { 0xFF, 0xFF };   /* 0xFFFF=opaque=black on 常白面板 */

    TFT_SetWindow(x, y, FONT_W, FONT_H);
    SPI_WriteCmd(0x2C);

    TFT_CS_LOW; TFT_DC_DATA;

    for (int row = 0; row < FONT_H; row++)
    {
        for (int col = 0; col < FONT_W; col++)
        {
            if (col < 5 && row < 8 && (glyph[col] & (1 << (7 - row))))
                HAL_SPI_Transmit(&hspi1, (uint8_t *)&color, 2, 100);
            else
                HAL_SPI_Transmit(&hspi1, bg, 2, 100);
        }
    }

    TFT_CS_HIGH;
}

void TFT_DrawStr(uint16_t x, uint16_t y, const char *s, uint16_t color)
{
    while (*s)
    {
        TFT_DrawChar(x, y, *s, color);
        x += FONT_W;
        s++;
    }
}

/* ── Init sequence ── */

typedef struct { uint8_t cmd, len; const uint8_t *param; } InitCmd;
static const uint8_t p_B1[]  = { 0x05,0x3C,0x3C };
static const uint8_t p_B2[]  = { 0x05,0x3C,0x3C };
static const uint8_t p_B3[]  = { 0x05,0x3C,0x3C,0x05,0x3C,0x3C };
static const uint8_t p_B4[]  = { 0x03 };
static const uint8_t p_C0[]  = { 0x0E,0x0E,0x04 };
static const uint8_t p_C1[]  = { 0xC5 };
static const uint8_t p_C2[]  = { 0x0D,0x00 };
static const uint8_t p_C3[]  = { 0x8D,0x2A };
static const uint8_t p_C4[]  = { 0x8D,0xEE };
static const uint8_t p_C5[]  = { 0x06 };
static const uint8_t p_36[]  = { 0xE0 };
static const uint8_t p_3A[]  = { 0x55 };
static const uint8_t p_E0[]  = { 0x0b,0x17,0x0a,0x0d,0x1a,0x19,0x16,0x1d,0x21,0x26,0x37,0x3c,0x00,0x09,0x05,0x01 };
static const uint8_t p_E1[]  = { 0x0c,0x19,0x09,0x0d,0x1b,0x19,0x15,0x1d,0x21,0x26,0x39,0x3E,0x00,0x09,0x05,0x10 };
static const InitCmd init_seq[] = {
    {0xB1,3,p_B1},{0xB2,3,p_B2},{0xB3,6,p_B3},{0xB4,1,p_B4},
    {0xC0,3,p_C0},{0xC1,1,p_C1},{0xC2,2,p_C2},{0xC3,2,p_C3},{0xC4,2,p_C4},{0xC5,1,p_C5},
    {0x36,1,p_36},{0x3A,1,p_3A},{0xE0,16,p_E0},{0xE1,16,p_E1},
};

void TFT_Init(void)
{
    TFT_CS_HIGH; TFT_DC_CMD;
    TFT_RST_LOW;  HAL_Delay(1);
    TFT_RST_HIGH; HAL_Delay(120);

    SPI_WriteCmdEx(0x11, NULL, 0); HAL_Delay(120);
    for (int i = 0; i < sizeof(init_seq)/sizeof(InitCmd); i++)
        SPI_WriteCmdEx(init_seq[i].cmd, (uint8_t *)init_seq[i].param, init_seq[i].len);
    HAL_Delay(120);
    SPI_WriteCmd(0x29);
}

/* ── Test ── */

void TFT_FillScreen(uint16_t color)
{
    TFT_SetWindow(0, 0, WIDTH, HEIGHT);

    SPI_WriteCmd(0x2C);
    TFT_CS_LOW; TFT_DC_DATA;
    uint8_t c[2] = { color >> 8, color & 0xFF };
    uint32_t count = (uint32_t)WIDTH * HEIGHT;
    for (uint32_t i = 0; i < count; i++)
        HAL_SPI_Transmit(&hspi1, c, 2, 100);
    TFT_CS_HIGH;
}

void TFT_Test(void)
{
    TFT_Init();
    TFT_FillScreen(0xFFFF);

    uint16_t colors[] = { 0xF800,0xFF80,0x07E0,0x07FF,0x001F,0xF81F,0xFFE0,0xFFFF };
    const char *text = "chaconne chaconne chaconne chaconne";

    for (int row = 0; row < 8; row++)
        TFT_DrawStr(0, row * 10, text, colors[row]);
}
